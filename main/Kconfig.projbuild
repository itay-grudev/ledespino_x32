## main/Kconfig.projbuild
```kconfig
menu "Ledespino Configuration"

config DEFAULT_DEVICE_NAME
    string "Default Device Name"
    default "Ledespino"
    help
        Default device name displayed in the UI.

config DEFAULT_HOSTNAME
    string "Default Hostname (mDNS)"
    default "ledespino"
    help
        Local hostname advertised by mDNS.

    menu "WiFi"
        choice DEFAULT_WIFI_MODE
            prompt "Default WiFi Mode: AP or STA"
            default DEFAULT_WIFI_MODE_AP
            help
                Whether to create a network by default or connect to an existing one.
                Useful for debugging purposes.

            config DEFAULT_WIFI_MODE_AP
                bool "Access Point"
                help
                    Create an AP with the specified SSID and password.
            config DEFAULT_WIFI_MODE_STA
                bool "Station"
                help
                    Connect to an existing AP with the specified SSID and password.
        endchoice

        config WIFI_SSID
            string "WiFi SSID"
            default "Ledespino"
            help
                SSID (network name) for the example to connect to.

        config WIFI_PASSWORD
            string "WiFi Password"
            default "lettherebelight"
            help
                WiFi password (WPA or WPA2) for the example to use.

                Can be left blank if the network has no security set.
    endmenu

    menu "LED"
        config LED_RED_PIN
            int "Red Pin"
            default 33
            help
                Pin number for PWM for the red channel.
        config LED_GREEN_PIN
            int "Green Pin"
            default 25
            help
                Pin number for PWM for the green channel.
        config LED_BLUE_PIN
            int "Blue Pin"
            default 32
            help
                Pin number for PWM for the blue channel.
    endmenu

    menu "Sensors"
        config SENSORS_LIGHT_PIN
            int "Photoresistor Pin"
            default 4
            help
                Pin number for the analogue photo resistor input.
        config SENSORS_DOOR_PIN
            int "Door Sensor Pin"
            default 16
            help
                Pin number for the door open/closed sensor.
    endmenu

    menu "HTTP"
        config HTTP_SERVER_PORT
            int "HTTP Port"
            default 80
            help
                Specify TCP port for the HTTP server.
    endmenu

endmenu
```
